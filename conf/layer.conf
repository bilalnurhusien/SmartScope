## conf/layer.conf
```bitbake
# We have a conf and classes directory, add to BBPATH
BBPATH .= ":${LAYERDIR}"

# We have recipes-* directories, add to BBFILES
BBFILES += "${LAYERDIR}/recipes-*/*/*.bb \
            ${LAYERDIR}/recipes-*/*/*.bbappend"

BBFILE_COLLECTIONS += "meta-smartscope"
BBFILE_PATTERN_meta-smartscope = "^${LAYERDIR}/"
BBFILE_PRIORITY_meta-smartscope = "6"

LAYERDEPENDS_meta-smartscope = "core"
LAYERSERIES_COMPAT_meta-smartscope = "thud"
```
